## drivers/cpufreq/Kconfig
```kconfig
menu "CPU Frequency scaling"

config CPU_FREQ
	bool "CPU Frequency scaling"
	help
	  CPU Frequency scaling allows you to change the clock speed of 
	  CPUs on the fly. This is a nice method to save power, because 
	  the lower the CPU clock speed, the less power the CPU consumes.

	  Note that this driver doesn't automatically change the CPU
	  clock speed, you need to either enable a dynamic cpufreq governor
	  (see below) after boot, or use a userspace tool.

	  For details, take a look at <file:Documentation/cpu-freq>.

	  If in doubt, say N.

if CPU_FREQ

config CPU_FREQ_TABLE
	tristate

config CPU_FREQ_STAT
	tristate "CPU frequency translation statistics"
	select CPU_FREQ_TABLE
	default y
	help
	  This driver exports CPU frequency statistics information through sysfs
	  file system.

	  To compile this driver as a module, choose M here: the
	  module will be called cpufreq_stats.

	  If in doubt, say N.

config CPU_FREQ_STAT_DETAILS
	bool "CPU frequency translation statistics details"
	depends on CPU_FREQ_STAT
	help
	  This will show detail CPU frequency translation table in sysfs file
	  system.

	  If in doubt, say N.

choice
	prompt "Default CPUFreq governor"
	default CPU_FREQ_DEFAULT_GOV_USERSPACE if CPU_FREQ_SA1100 || CPU_FREQ_SA1110
	default CPU_FREQ_DEFAULT_GOV_PERFORMANCE
	help
	  This option sets which CPUFreq governor shall be loaded at
	  startup. If in doubt, select 'performance'.

config CPU_FREQ_DEFAULT_GOV_PERFORMANCE
	bool "performance"
	select CPU_FREQ_GOV_PERFORMANCE
	help
	  Use the CPUFreq governor 'performance' as default. This sets
	  the frequency statically to the highest frequency supported by
	  the CPU.

config CPU_FREQ_DEFAULT_GOV_POWERSAVE
	bool "powersave"
	depends on EXPERT
	select CPU_FREQ_GOV_POWERSAVE
	help
	  Use the CPUFreq governor 'powersave' as default. This sets
	  the frequency statically to the lowest frequency supported by
	  the CPU.

config CPU_FREQ_DEFAULT_GOV_USERSPACE
	bool "userspace"
	select CPU_FREQ_GOV_USERSPACE
	help
	  Use the CPUFreq governor 'userspace' as default. This allows
	  you to set the CPU frequency manually or when a userspace 
	  program shall be able to set the CPU dynamically without having
	  to enable the userspace governor manually.

config CPU_FREQ_DEFAULT_GOV_ONDEMAND
	bool "ondemand"
	select CPU_FREQ_GOV_ONDEMAND
	select CPU_FREQ_GOV_PERFORMANCE
	help
	  Use the CPUFreq governor 'ondemand' as default. This allows
	  you to get a full dynamic frequency capable system by simply
	  loading your cpufreq low-level hardware driver.
	  Be aware that not all cpufreq drivers support the ondemand
	  governor. If unsure have a look at the help section of the
	  driver. Fallback governor will be the performance governor.

config CPU_FREQ_DEFAULT_GOV_CONSERVATIVE
	bool "conservative"
	select CPU_FREQ_GOV_CONSERVATIVE
	select CPU_FREQ_GOV_PERFORMANCE
	help
	  Use the CPUFreq governor 'conservative' as default. This allows
	  you to get a full dynamic frequency capable system by simply
	  loading your cpufreq low-level hardware driver.
	  Be aware that not all cpufreq drivers support the conservative
	  governor. If unsure have a look at the help section of the
	  driver. Fallback governor will be the performance governor.

config CPU_FREQ_DEFAULT_GOV_PRESERVATIVE
	bool "preservative"
	select CPU_FREQ_GOV_PRESERVATIVE
	select CPU_FREQ_GOV_PERFORMANCE
	help
	  Use the CPUFreq governor 'preservative' as default. This allows
	  you to eat jam.

config CPU_FREQ_DEFAULT_GOV_INTERACTIVE
	bool "interactive"
	select CPU_FREQ_GOV_INTERACTIVE
	help
	  Use the CPUFreq governor 'interactive' as default. This allows
	  you to get a full dynamic cpu frequency capable system by simply
	  loading your cpufreq low-level hardware driver, using the
	  'interactive' governor for latency-sensitive workloads.

config CPU_FREQ_DEFAULT_GOV_SMARTMAX
    bool "smartmax"
    select CPU_FREQ_GOV_SMARTMAX
    help
      Use the CPUFreq governor 'smartmax' as default. 

config CPU_FREQ_DEFAULT_GOV_INTELLIDEMAND
	bool "intellidemand"
	select CPU_FREQ_GOV_INTELLIDEMAND
	help
	  Use the CPUFreq governor 'intellidemand' as default.

config CPU_FREQ_DEFAULT_GOV_SMARTASSV2
	bool "smartass2"
	select CPU_FREQ_GOV_SMARTASSV2
	help
		Use the CPUFreq governor 'smartassV2' as default.

config CPU_FREQ_DEFAULT_GOV_BADASS
	bool "badass"
	select CPU_FREQ_GOV_BADASS
	help
	  'badass' - This driver adds a dynamic cpufreq policy governor.
	  The governor does a periodic polling and

config CPU_FREQ_DEFAULT_GOV_LIONHEART
	bool "lionheart"
	select CPU_FREQ_GOV_LIONHEART
	help
	 Use the CPUFreq governor 'lionheart' as default.

config CPU_FREQ_DEFAULT_GOV_INTERACTIVEX2
  	bool "interactiveX"
  	select CPU_FREQ_GOV_INTERACTIVEX2
  	help
    	  Use the CPUFreq governor 'interactiveX2' as default.

config CPU_FREQ_DEFAULT_GOV_LAGFREE
        bool "lagfree"
        select CPU_FREQ_GOV_LAGFREE
        help
          Use the CPUFreq governor 'lagfree' as default. This allows
          you to get a full dynamic frequency capable system by simply
          loading your cpufreq low-level hardware driver.
          Be aware that not all cpufreq drivers support the lagfree
          governor. If unsure have a look at the help section of the
          driver. Fallback governor will be the performance governor.	  

endchoice

config CPU_FREQ_GOV_LIONHEART
	tristate "lionheart"
	depends on CPU_FREQ
	help
	 Use the CPUFreq governor 'lionheart' as default.

	  If in doubt, say N.

config CPU_FREQ_GOV_SMARTASSV2
	tristate "'smartassV2' cpufreq governor"
	depends on CPU_FREQ
	help
		'smartassV2' - a "smart" governor
		If in doubt, say N.

config SMARTASSV2_SLEEP_IDEAL_FREQ
	int "The ideal frequency to use when awake."
	default 768000
	depends on CPU_FREQ_GOV_SMARTASSV2
	help
	  The "ideal" frequency to use when awake. The governor will ramp up faster
	  towards the ideal frequency and slower after it has passed it. Similarly,
	  lowering the frequency towards the ideal frequency is faster than below it.

config SMARTASSV2_AWAKE_IDEAL_FREQ
	int "The ideal frequency to use when suspended."
	default 192000
	depends on CPU_FREQ_GOV_SMARTASSV2
	help
	  The "ideal" frequency to use when suspended.
	  When set to 0, the governor will not track the suspended state (meaning
	  that practically when sleep_ideal_freq==0 the awake_ideal_freq is used
	  also when suspended).

config SMARTASSV2_RAMP_UP_STEP
	int "Freqeuncy delta when ramping up above the ideal freqeuncy."
	default 256000
	depends on CPU_FREQ_GOV_SMARTASSV2
	help
	  Freqeuncy delta when ramping up above the ideal freqeuncy.
	  Zero disables and causes to always jump straight to max frequency.
	  When below the ideal freqeuncy we always ramp up to the ideal freq.

config SMARTASSV2_RAMP_DOWN_STEP
	int "Freqeuncy delta when ramping down below the ideal freqeuncy."
	default 256000
	depends on CPU_FREQ_GOV_SMARTASSV2
	help
	  Freqeuncy delta when ramping down below the ideal freqeuncy.
	  Zero disables and will calculate ramp down according to load heuristic.
	  When above the ideal freqeuncy we always ramp down to the ideal freq.

config SMARTASSV2_MAX_CPU_LOAD
	int "CPU freq will be increased if measured load > max_cpu_load."
	default 50
	depends on CPU_FREQ_GOV_SMARTASSV2
	help
	  CPU freq will be increased if measured load > max_cpu_load.

config SMARTASSV2_MIN_CPU_LOAD
	int "CPU freq will be decreased if measured load < max_cpu_load."
	default 25
	depends on CPU_FREQ_GOV_SMARTASSV2
	help
	  CPU freq will be decreased if measured load < max_cpu_load.

config SMARTASSV2_UP_RATE_US
	int "The minimum amount of time to spend at a frequency before we can ramp up."
	default 48000
	depends on CPU_FREQ_GOV_SMARTASSV2
	help
	  The minimum amount of time to spend at a frequency before we can ramp up.
	  Notice we ignore this when we are below the ideal frequency.

config SMARTASSV2_DOWN_RATE_US
	int "The minimum amount of time to spend at a frequency before we can ramp down."
	default 99000
	depends on CPU_FREQ_GOV_SMARTASSV2
	help
	  The minimum amount of time to spend at a frequency before we can ramp down.
	  Notice we ignore this when we are below the ideal frequency.

config SMARTASSV2_SLEEP_WAKEUP_FREQ
	int "The frequency to set when waking up from sleep."
	default 99999999
	depends on CPU_FREQ_GOV_SMARTASSV2
	help
	  The frequency to set when waking up from sleep.
	  When sleep_ideal_freq=0 this will have no effect.

config SMARTASSV2_SAMPLE_RATE_JIFFIES
	int "Sampling rate."
	default 2
	depends on CPU_FREQ_GOV_SMARTASSV2
	help
	  Sampling rate, I highly recommend to leave it at 2.

config CPU_FREQ_GOV_BADASS
	tristate "'badass' cpufreq governor"
	depends on CPU_FREQ
	help
	  'badass' - This driver adds a dynamic cpufreq policy governor.
	  The governor does a periodic polling and
	  changes frequency based on the CPU utilization.
	  The support for this governor depends on CPU capability to
	  do fast frequency switching (i.e, very low latency frequency
	  transitions).

	  If in doubt, say N.

config CPU_FREQ_GOV_BADASS_2_PHASE
	tristate "'2-phase' power-efficiency badass algorithm"
	depends on CPU_FREQ_GOV_BADASS
	help
	 '2-phase' - This driver adds a new algo to save power

config CPU_FREQ_GOV_BADASS_2_PHASE_FREQ
	int "'2-phase' badass frequency"
	default 918000
	depends on CPU_FREQ_GOV_BADASS
	depends on CPU_FREQ_GOV_BADASS_2_PHASE

config CPU_FREQ_GOV_BADASS_3_PHASE
	tristate "'3-phase' power-efficiency badass algorithm"
	depends on CPU_FREQ_GOV_BADASS
	depends on CPU_FREQ_GOV_BADASS_2_PHASE
	help
	  '3-phase' - This driver adds a new algo to save power

config CPU_FREQ_GOV_BADASS_3_PHASE_FREQ
	int "'3-phase' badass frequency"
	default 1188000
	depends on CPU_FREQ_GOV_BADASS
	depends on CPU_FREQ_GOV_BADASS_2_PHASE
	depends on CPU_FREQ_GOV_BADASS_3_PHASE

config CPU_FREQ_GOV_BADASS_GPU_CONTROL
	tristate "'gpu_control' power-efficiency badass algorithm"
	depends on CPU_FREQ_GOV_BADASS
	depends on CPU_FREQ_GOV_BADASS_2_PHASE
	help
	  'gpu_control' - This driver adds a new algo to save power

config CPU_FREQ_GOV_BADASS_LOWBAT_POWERSAVE
	tristate "'lowbat_powersave' power-efficiency badass algorithm"
	depends on CPU_FREQ_GOV_BADASS
	help
	  'lowbat_powersave' - This driver adds a new algo to save power

config CPU_FREQ_GOV_BADASS_ALLOW_BYPASS
	tristate "Allows bypassing phases"
	depends on CPU_FREQ_GOV_BADASS
	depends on CPU_FREQ_GOV_BADASS_2_PHASE
	help
	  'allow_bypass' - This driver adds a bypass to the phases





config CPU_FREQ_GOV_LAGFREE
        tristate "'lagfree' cpufreq governor"
        depends on CPU_FREQ
        help
          'lagfree' - this driver is rather similar to the 'ondemand'
          governor both in its source code and its purpose, the difference is
          its optimisation for better suitability in a battery powered
          environment.  The frequency is gracefully increased and decreased
          rather than jumping to 100% when speed is required.

config LAGFREE_MAX_LOAD
	int "Max CPU Load"
	default 50
	depends on CPU_FREQ_GOV_LAGFREE
	help
	  CPU freq will be increased if measured load > max_cpu_load;

config LAGFREE_MIN_LOAD
	int "Min CPU Load"
	default 15
	depends on CPU_FREQ_GOV_LAGFREE
	help
	  CPU freq will be decrease if measured load < min_cpu_load;

config LAGFREE_FREQ_STEP_DOWN
	int "Frequency Step Down"
	default 108000
	depends on CPU_FREQ_GOV_LAGFREE
	help
	  Max freqeuncy delta when ramping down.

config LAGFREE_FREQ_SLEEP_MAX
	int "Max Sleep frequeny"
	default 384000
	depends on CPU_FREQ_GOV_LAGFREE
	help
	  Max freqeuncy for screen off.

config LAGFREE_FREQ_AWAKE_MIN
	int "Min Awake frequeny"
	default 384000
	depends on CPU_FREQ_GOV_LAGFREE
	help
	  Min freqeuncy for screen on.

config LAGFREE_FREQ_STEP_UP_SLEEP_PERCENT
	int "Freq step up percent sleep"
	default 20
	depends on CPU_FREQ_GOV_LAGFREE
	help
	  Frequency percent to step up while screen off.

config CPU_FREQ_GOV_PERFORMANCE
	tristate "'performance' governor"
	help
	  This cpufreq governor sets the frequency statically to the
	  highest available CPU frequency.

	  To compile this driver as a module, choose M here: the
	  module will be called cpufreq_performance.

	  If in doubt, say Y.

config CPU_FREQ_GOV_POWERSAVE
	tristate "'powersave' governor"
	help
	  This cpufreq governor sets the frequency statically to the
	  lowest available CPU frequency.

	  To compile this driver as a module, choose M here: the
	  module will be called cpufreq_powersave.

	  If in doubt, say Y.

config CPU_FREQ_GOV_USERSPACE
	tristate "'userspace' governor for userspace frequency scaling"
	help
	  Enable this cpufreq governor when you either want to set the
	  CPU frequency manually or when a userspace program shall
	  be able to set the CPU dynamically, like on LART 
	  <http://www.lartmaker.nl/>.

	  To compile this driver as a module, choose M here: the
	  module will be called cpufreq_userspace.

	  For details, take a look at <file:Documentation/cpu-freq/>.

	  If in doubt, say Y.

config CPU_FREQ_GOV_ONDEMAND
	tristate "'ondemand' cpufreq policy governor"
	select CPU_FREQ_TABLE
	help
	  'ondemand' - This driver adds a dynamic cpufreq policy governor.
	  The governor does a periodic polling and 
	  changes frequency based on the CPU utilization.
	  The support for this governor depends on CPU capability to
	  do fast frequency switching (i.e, very low latency frequency
	  transitions). 

	  To compile this driver as a module, choose M here: the
	  module will be called cpufreq_ondemand.

	  For details, take a look at linux/Documentation/cpu-freq.

	  If in doubt, say N.

config CPU_FREQ_GOV_ONDEMAND_2_PHASE
	bool "'2-phase' power-efficiency ondemand algorithm"
	depends on CPU_FREQ_GOV_ONDEMAND
	help
	  '2-phase' - This driver adds a new algo to save power

config CPU_FREQ_GOV_ONDEMAND_MULTI_PHASE
	bool "'multi-phase' power-efficiency ondemand algorithm"
	depends on CPU_FREQ_GOV_ONDEMAND
	help
	  'multi-phase' - This driver adds a new algo to save power

config CPU_FREQ_GOV_INTERACTIVE
	tristate "'interactive' cpufreq policy governor"
	help
	  'interactive' - This driver adds a dynamic cpufreq policy governor
	  designed for latency-sensitive workloads.

	  This governor attempts to reduce the latency of clock
	  increases so that the system is more responsive to
	  interactive workloads.

	  To compile this driver as a module, choose M here: the
	  module will be called cpufreq_interactive.

	  For details, take a look at linux/Documentation/cpu-freq.

	  If in doubt, say N.

config CPU_FREQ_GOV_CONSERVATIVE
	tristate "'conservative' cpufreq governor"
	depends on CPU_FREQ
	help
	  'conservative' - this driver is rather similar to the 'ondemand'
	  governor both in its source code and its purpose, the difference is
	  its optimisation for better suitability in a battery powered
	  environment.  The frequency is gracefully increased and decreased
	  rather than jumping to 100% when speed is required.

	  If you have a desktop machine then you should really be considering
	  the 'ondemand' governor instead, however if you are using a laptop,
	  PDA or even an AMD64 based computer (due to the unacceptable
	  step-by-step latency issues between the minimum and maximum frequency
	  transitions in the CPU) you will probably want to use this governor.

	  To compile this driver as a module, choose M here: the
	  module will be called cpufreq_conservative.

	  For details, take a look at linux/Documentation/cpu-freq.

	  If in doubt, say N.

config CPU_FREQ_GOV_PRESERVATIVE
	tristate "'preservative' cpufreq governor"
	depends on CPU_FREQ
	help
	  'preservative' - this driver is good in cakes

	  If in doubt, say N.

	  If not in doubt, say N.

config CPU_FREQ_GOV_SMARTMAX
        tristate "'smartmax' cpufreq policy governor"
        select CPU_FREQ_TABLE
        help
          'smartmax' combined ondemand and smartass2

config CPU_FREQ_GOV_SMARTMAX_TEGRA
        bool "'smartmax' for tegra"
        depends on CPU_FREQ_GOV_SMARTMAX || CPU_FREQ_GOV_SMARTMAX_EPS

config CPU_FREQ_GOV_SMARTMAX_30
        bool "'smartmax' for 3.0 and 3.1 kernels"
        depends on CPU_FREQ_GOV_SMARTMAX || CPU_FREQ_GOV_SMARTMAX_EPS

config CPU_FREQ_GOV_SMARTMAX_ENRC2B
        bool "'smartmax' defaults for enrc2b"
        depends on CPU_FREQ_GOV_SMARTMAX || CPU_FREQ_GOV_SMARTMAX_EPS

config CPU_FREQ_GOV_SMARTMAX_PRIMOU
        bool "'smartmax' defaults for primou"
        depends on CPU_FREQ_GOV_SMARTMAX || CPU_FREQ_GOV_SMARTMAX_EPS

config CPU_FREQ_GOV_SMARTMAX_M7
        bool "'smartmax' defaults for m7"
        depends on CPU_FREQ_GOV_SMARTMAX || CPU_FREQ_GOV_SMARTMAX_EPS

config CPU_FREQ_GOV_SMARTMAX_EPS
        tristate "'smartmax EPS' cpufreq policy governor"
        select CPU_FREQ_TABLE
        help
          'smartmax EPS' is the extreme powersaving version of smartmax

config CPU_FREQ_GOV_INTELLIDEMAND
        tristate "'intellidemand' cpufreq policy governor"
        select CPU_FREQ_TABLE
        help
          'intellidemand' - This driver adds a dynamic cpufreq policy governor.
          The governor does a periodic polling and
          changes frequency based on the CPU utilization.
          The support for this governor depends on CPU capability to
          do fast frequency switching (i.e, very low latency frequency
          transitions). with browsing detection based on GPU loading

          To compile this driver as a module, choose M here: the
          module will be called cpufreq_ondemand.

          For details, take a look at linux/Documentation/cpu-freq.

          If in doubt, say N.

config CPU_FREQ_GOV_INTELLIACTIVE
	tristate "'intelliactive' cpufreq policy governor"
	help
	  'intelliactive' - This driver adds a dynamic cpufreq policy governor
	  designed for latency-sensitive workloads.

	  This governor attempts to reduce the latency of clock
	  increases so that the system is more responsive to
	  interactive workloads.

	  To compile this driver as a module, choose M here: the
	  module will be called cpufreq_interactive.

	  For details, take a look at linux/Documentation/cpu-freq.

	  If in doubt, say N.

config CPU_FREQ_MIN_TICKS
	int "Ticks between governor polling interval."
	default 10
	help
	  Minimum number of ticks between polling interval for governors.

config CPU_FREQ_SAMPLING_LATENCY_MULTIPLIER
	int "Sampling rate multiplier for governors."
	default 1000
	help
	  Sampling latency rate multiplied by the cpu switch latency.
	  Affects governor polling.


config CPU_FREQ_GOV_NIGHTMARE
	tristate "'nightmare' cpufreq policy governor"


config CPU_FREQ_GOV_WREXY
	tristate "'wrexy' cpufreq policy governor"

menu "x86 CPU frequency scaling drivers"
depends on X86
source "drivers/cpufreq/Kconfig.x86"
endmenu

menu "ARM CPU frequency scaling drivers"
depends on ARM
source "drivers/cpufreq/Kconfig.arm"
endmenu

menu "PowerPC CPU frequency scaling drivers"
depends on PPC32 || PPC64
source "drivers/cpufreq/Kconfig.powerpc"
endmenu

endif
endmenu
```
